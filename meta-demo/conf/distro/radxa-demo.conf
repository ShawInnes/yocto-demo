## meta-demo/conf/layer.conf
```bitbake
BBPATH .= ":${LAYERDIR}"
BBFILES += "${LAYERDIR}/recipes-*/*/*.bb ${LAYERDIR}/recipes-*/*/*.bbappend"

BBFILE_COLLECTIONS += "demo"
BBFILE_PATTERN_demo = "^${LAYERDIR}/"
BBFILE_PRIORITY_demo = "10"

LAYERDEPENDS_demo = "core rockchip rauc"
LAYERSERIES_COMPAT_demo = "scarthgap"
```

## meta-demo/files/wic/rauc-qemuarm64.wks
```
# QEMU ARM64 RAUC A/B disk layout

# EFI System Partition
part /boot --source bootimg-efi --sourceparams="loader=grub-efi" --ondisk sda --fstype=vfat --use-uuid --label boot --active --align 1024 --size 128

# Root filesystem A
part / --source rootfs --ondisk sda --fstype=ext4 --use-uuid --label rootfsA --part-name rootfsA --align 1024 --size 1024

# Root filesystem B
part --ondisk sda --fstype=ext4 --label rootfsB --part-name rootfsB --align 1024 --size 1024

# Persistent data
part --ondisk sda --fstype=ext4 --use-uuid --label data --align 1024 --size 256

bootloader --ptable gpt --timeout=5
```

## meta-kvm/conf/layer.conf
```bitbake
BBPATH .= ":${LAYERDIR}"
BBFILES += "${LAYERDIR}/recipes-*/*/*.bb ${LAYERDIR}/recipes-*/*/*.bbappend"

BBFILE_COLLECTIONS += "kvm"
BBFILE_PATTERN_kvm = "^${LAYERDIR}/"
BBFILE_PRIORITY_kvm = "10"

LAYERDEPENDS_kvm = "core rockchip rauc"
LAYERSERIES_COMPAT_kvm = "scarthgap"
```

## meta-kvm/wic/rauc-qemuarm64.wks
```
# QEMU ARM64 RAUC A/B disk layout

# EFI System Partition
part /boot --source bootimg-efi --sourceparams="loader=grub-efi" --ondisk sda --fstype=vfat --label boot --active --align 1024 --size 128

# Root filesystem A
part / --source rootfs --ondisk sda --fstype=ext4 --label rootfsA --align 1024 --size 1024

# Root filesystem B
part --ondisk sda --fstype=ext4 --label rootfsB --align 1024 --size 1024

# Persistent data
part /data --ondisk sda --fstype=ext4 --label data --align 1024 --size 256

bootloader --ptable gpt --timeout=5
```
